## Config.in
```kconfig
menu "Udpcast"

source udpcast/dialog/Config.in

config CONFIG_UDPRECEIVER
	bool "UDPRECEIVER"
	default y
	help
	  Udpcast receiver

config CONFIG_UDPSENDER
	bool "UDPSENDER"
	default y
	help
	  Udpcast sender

endmenu
```
